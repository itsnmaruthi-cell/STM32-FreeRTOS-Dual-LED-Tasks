# file: RTOS_01.ioc
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FREERTOS.Tasks01=defaultTask,24,128,StartDefaultTask,Default,NULL,Dynamic,NULL,NULL
Mcu.Family=STM32F4
Mcu.Name=STM32F401R(D-E)Tx
Mcu.Package=LQFP64
NVIC.PriorityGroup=NVIC_PRIORITYGROUP_4
NVIC.TIM2_IRQn=true\:15\:0\:false\:false\:true\:false\:false\:true\:true
NVIC.TimeBase=TIM2_IRQn
NVIC.TimeBaseIP=TIM2
ProjectManager.HeapSize=0x200
ProjectManager.StackSize=0x400
ProjectManager.TargetToolchain=STM32CubeIDE
RCC.AHBFreq_Value=16000000
RCC.APB1Freq_Value=16000000
RCC.APB2Freq_Value=16000000
RCC.CortexFreq_Value=16000000
RCC.HSE_VALUE=25000000
RCC.HSI_VALUE=16000000
RCC.LSE_VALUE=32768
RCC.SYSCLKFreq_VALUE=16000000
RCC.VCOOutputFreq_Value=192000000
VP_FREERTOS_VS_CMSIS_V2.Mode=CMSIS_V2
VP_SYS_VS_tim2.Mode=TIM2
board=custom

// file: Core/Src/main.c
/* USER CODE BEGIN Header */

/**
  ******************************************************************************
  * @file           : main.c
  * @brief          : Main program body
  ******************************************************************************
  * @attention
  *
  * Copyright (c) 2026 STMicroelectronics.
  * All rights reserved.
  *
  * This software is licensed under terms that can be found in the LICENSE file
  * in the root directory of this software component.
  * If no LICENSE file comes with this software, it is provided AS-IS.
  *
  ******************************************************************************
  */

/* USER CODE END Header */

#include "main.h"
#include "FreeRTOS.h"
#include "task.h"

void SystemClock_Config(void);

/* USER CODE BEGIN PFP */

void LED_Task1(void *argument);
void LED_Task2(void *argument);

/* USER CODE END PFP */

/* USER CODE BEGIN 0 */

volatile uint32_t* RCC_AHB1ENR = (volatile uint32_t*)0x40023830;
volatile uint32_t* GPIOA_MODER = (volatile uint32_t*)0x40020000;
volatile uint32_t* GPIOA_BSRR = (volatile uint32_t*)0x40020018;

/* USER CODE END 0 */

int main(void)
{

  /* MCU Configuration--------------------------------------------------------*/

  HAL_Init();

  SystemClock_Config();

  /* Initialize all configured peripherals */
  /* USER CODE BEGIN 2 */

  *RCC_AHB1ENR |= (1U << 0);

  *GPIOA_MODER &= ~(3U << 10);
  *GPIOA_MODER |= (1U << 10);

  *GPIOA_MODER &= ~(3U << 12);
  *GPIOA_MODER |= (1U << 12);

  /* USER CODE END 2 */

  /* USER CODE BEGIN RTOS */

  xTaskCreate(LED_Task1, "LED1", 256, NULL, 1, NULL);
  xTaskCreate(LED_Task2, "LED2", 256, NULL, 1, NULL);

  vTaskStartScheduler();

  /* USER CODE END RTOS */

  while (1)
  {
  }
}

void SystemClock_Config(void)
{
  RCC_OscInitTypeDef RCC_OscInitStruct = {0};
  RCC_ClkInitTypeDef RCC_ClkInitStruct = {0};

  __HAL_RCC_PWR_CLK_ENABLE();

  __HAL_PWR_VOLTAGESCALING_CONFIG(PWR_REGULATOR_VOLTAGE_SCALE2);

  RCC_OscInitStruct.OscillatorType = RCC_OSCILLATORTYPE_HSI;
  RCC_OscInitStruct.HSIState = RCC_HSI_ON;
  RCC_OscInitStruct.HSICalibrationValue = RCC_HSICALIBRATION_DEFAULT;
  RCC_OscInitStruct.PLL.PLLState = RCC_PLL_NONE;

  if (HAL_RCC_OscConfig(&RCC_OscInitStruct) != HAL_OK)
  {
    Error_Handler();
  }

  RCC_ClkInitStruct.ClockType = RCC_CLOCKTYPE_HCLK |
                                 RCC_CLOCKTYPE_SYSCLK |
                                 RCC_CLOCKTYPE_PCLK1 |
                                 RCC_CLOCKTYPE_PCLK2;

  RCC_ClkInitStruct.SYSCLKSource = RCC_SYSCLKSOURCE_HSI;
  RCC_ClkInitStruct.AHBCLKDivider = RCC_SYSCLK_DIV1;
  RCC_ClkInitStruct.APB1CLKDivider = RCC_HCLK_DIV1;
  RCC_ClkInitStruct.APB2CLKDivider = RCC_HCLK_DIV1;

  if (HAL_RCC_ClockConfig(&RCC_ClkInitStruct, FLASH_LATENCY_0) != HAL_OK)
  {
    Error_Handler();
  }
}

void Error_Handler(void)
{
  __disable_irq();

  while (1)
  {
  }
}

// file: Core/Src/freertos.c
/* USER CODE BEGIN Header */
/**
  ******************************************************************************
  * File Name          : freertos.c
  * Description        : Code for freertos applications
  ******************************************************************************
  * @attention
  *
  * Copyright (c) 2026 STMicroelectronics.
  * All rights reserved.
  *
  * This software is licensed under terms that can be found in the LICENSE file
  * in the root directory of this software component.
  * If no LICENSE file comes with this software, it is provided AS-IS.
  *
  ******************************************************************************
  */
/* USER CODE END Header */

#include "FreeRTOS.h"
#include "task.h"
#include "main.h"

/* USER CODE BEGIN Includes */
extern volatile uint32_t* GPIOA_BSRR;//this is already in main.c
//we are just making a ocnnection between main.c and freertos.c

/* USER CODE END Includes */

/* USER CODE BEGIN Application */
void LED_Task1(void* arguments){
	while(1){
		*GPIOA_BSRR=(1U<<5);
		vTaskDelay(pdMS_TO_TICKS(500));
		*GPIOA_BSRR=(1U<<(5+16));
		vTaskDelay(pdMS_TO_TICKS(500));
		//total cycle is 1000ms
	}
}
void LED_Task2(void* arguments){
	while(1){
			*GPIOA_BSRR=(1U<<6);
			vTaskDelay(pdMS_TO_TICKS(1000));
			*GPIOA_BSRR=(1U<<(6+16));
			vTaskDelay(pdMS_TO_TICKS(1000));
			//total cycle is 2000ms
	}
}

/* USER CODE END Application */
